#include <Wire.h>
#include <Adafruit_GFX.h>
#include <Adafruit_SSD1306.h>
// #include <DHT11.h>
#include <DHTesp.h>
#include <WiFi.h>
#include <Servo.h>
#include <PubSubClient.h>

#define SCREEN_WIDTH 128
#define SCREEN_HEIGHT 64
#define OLED_RESET -1
#define SCREEN_ADDRESS 0x3C

#define BUZZER 5
#define LED_1 2
#define PB_CANCEL 34
#define PB_OK 25
#define PB_UP 26
#define PB_DOWN 35
#define DHTPIN 12
#define LDR_RIGHT 32
#define LDR_LEFT 33
#define SERVO_PIN 27

#define NTP_SERVER "pool.ntp.org"
// #define UTC_OFFSET     19800
#define UTC_OFFSET_DST 0
#define D_RIGHT 0.5
#define D_LEFT 1.5
#define MAX_TEMPERATURE 32
#define MIN_TEMPERATURE 26
#define MAX_HUMIDITY 80
#define MIN_HUMIDITY 60

// Declare Objects
Adafruit_SSD1306 display(SCREEN_WIDTH, SCREEN_HEIGHT, &Wire, OLED_RESET);

// DHT11 dhtSensor(4);
DHTesp dhtSensor;

Servo servo;
WiFiClient espClient;
PubSubClient mqttClient(espClient);

// global variables
float left_intensity;
float right_intensity;

float angle_offset;
float controlling_factor;

int UTC_OFFSET = 19800;
int days = 0;
int hours = 0;
int minutes = 0;
int seconds = 0;

unsigned long timeNow = 0;
unsigned long timeLast = 0;

bool alarm_enabled = false;
int n_alarms = 3;
int alarm_hours[] = {0, 0, 0};
int alarm_minutes[] = {0, 0, 0};
bool alarm_triggered[] = {false, false, false};

int n_notes = 8;
int C = 262;
int D = 294;
int E = 330;
int F = 349;
int G = 392;
int A = 440;
int B = 494;
int C_H = 523;
int notes[] = {C, D, E, F, G, A, B, C_H};

int current_mode = 0;
int max_modes = 5;
String modes[] = {"1 - Set Time", "2 - Set Alarm 1", "3 - Set Alarm 2", "4 - Set Alarm 3", "5 - Disable Alarm"};

int temperature = 0;
int humidity = 0;

const unsigned char high_temp[] PROGMEM = {
    // 'Screenshot 2024-03-02 121602, 128x63px
    0xff, 0xff, 0xff, 0xff, 0xff, 0xff, 0xff, 0xff, 0xff, 0xff, 0xff, 0xff, 0xff, 0xff, 0xff, 0xff,
    0xff, 0xff, 0xff, 0xff, 0xff, 0xff, 0xff, 0xff, 0xff, 0xff, 0xff, 0xff, 0xff, 0xff, 0xff, 0xff,
    0xff, 0xff, 0xff, 0xff, 0xff, 0xff, 0xff, 0xff, 0xff, 0xff, 0xff, 0xff, 0xff, 0xff, 0xff, 0xff,
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    0xff, 0xff, 0xff, 0xff, 0xff, 0xff, 0xff, 0xff, 0xff, 0xff, 0xff, 0xff, 0xff, 0xff, 0xff, 0xff};

const unsigned char low_temp[] PROGMEM = {
    // 'Screenshot 2024-03-02 121941, 128x64px
    0xff, 0xff, 0xff, 0xff, 0xff, 0xff, 0xff, 0xff, 0xff, 0xff, 0xff, 0xff, 0xff, 0xff, 0xff, 0xff,
    0xff, 0xff, 0xff, 0xff, 0xff, 0xff, 0xff, 0xff, 0xff, 0xff, 0xff, 0xff, 0xff, 0xff, 0xff, 0xff,
    0xff, 0xff, 0xff, 0xff, 0xff, 0xff, 0xff, 0xff, 0xff, 0xff, 0xff, 0xff, 0xff, 0xff, 0xff, 0xff,
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    0xff, 0xff, 0xff, 0xff, 0xff, 0xff, 0xff, 0xff, 0xff, 0xff, 0xff, 0xff, 0xff, 0xff, 0xff, 0xff};

const unsigned char high_humidity[] PROGMEM = {
    // 'Screenshot 2024-03-02 122144, 128x64px
    0xff, 0xff, 0xff, 0xff, 0xff, 0xff, 0xff, 0xff, 0xff, 0xff, 0xff, 0xff, 0xff, 0xff, 0xff, 0xff,
    0xff, 0xff, 0xff, 0xff, 0xff, 0xff, 0xff, 0xff, 0xff, 0xff, 0xff, 0xff, 0xff, 0xff, 0xff, 0xff,
    0xff, 0xff, 0xff, 0xff, 0xff, 0xff, 0xff, 0xff, 0xff, 0xff, 0xff, 0xff, 0xff, 0xff, 0xff, 0xff,
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    0xff, 0xff, 0xff, 0xff, 0xff, 0xff, 0xff, 0xff, 0xff, 0xff, 0xff, 0xff, 0xff, 0xff, 0xff, 0xff};

const unsigned char low_humidity[] PROGMEM = {
    // 'Screenshot 2024-03-02 124412, 128x64px
    0xff, 0xff, 0xff, 0xff, 0xff, 0xff, 0xff, 0xff, 0xff, 0xff, 0xff, 0xff, 0xff, 0xff, 0xff, 0xff,
    0xff, 0xff, 0xff, 0xff, 0xff, 0xff, 0xff, 0xff, 0xff, 0xff, 0xff, 0xff, 0xff, 0xff, 0xff, 0xff,
    0xff, 0xff, 0xff, 0xff, 0xff, 0xff, 0xff, 0xff, 0xff, 0xff, 0xff, 0xff, 0xff, 0xff, 0xff, 0xff,
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    0xff, 0xff, 0xff, 0xff, 0xff, 0xff, 0xff, 0xff, 0xff, 0xff, 0xff, 0xff, 0xff, 0xff, 0xff, 0xff};

const unsigned char medicine_time[] PROGMEM = {
    // 'Screenshot 2024-03-02 122506, 128x64px
    0xff, 0xff, 0xff, 0xff, 0xff, 0xff, 0xff, 0xff, 0xff, 0xff, 0xff, 0xff, 0xff, 0xff, 0xff, 0xff,
    0xff, 0xff, 0xff, 0xff, 0xff, 0xff, 0xff, 0xff, 0xff, 0xff, 0xff, 0xff, 0xff, 0xff, 0xff, 0xff,
    0xff, 0xff, 0xff, 0xff, 0xff, 0xff, 0xff, 0xff, 0xff, 0xff, 0xff, 0xff, 0xff, 0xff, 0xff, 0xff,
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    0xff, 0xff, 0xff, 0xff, 0xff, 0xff, 0xff, 0xff, 0xff, 0xff, 0xff, 0xff, 0xff, 0xff, 0xff, 0xff};

const unsigned char connect_1[] PROGMEM = {
    // 'Screenshot 2024-03-02 123821, 128x64px
    0xff, 0xff, 0xff, 0xff, 0xff, 0xff, 0xff, 0xff, 0xff, 0xff, 0xff, 0xff, 0xff, 0xff, 0xff, 0xff,
    0xff, 0xff, 0xff, 0xff, 0xff, 0xff, 0xff, 0xff, 0xff, 0xff, 0xff, 0xff, 0xff, 0xff, 0xff, 0xff,
    0xff, 0xff, 0xff, 0xff, 0xff, 0xff, 0xff, 0xff, 0xff, 0xff, 0xff, 0xff, 0xff, 0xff, 0xff, 0xff,
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    0xff, 0xff, 0xff, 0xff, 0xff, 0xff, 0xff, 0xff, 0xff, 0xff, 0xff, 0xff, 0xff, 0xff, 0xff, 0xff};

const unsigned char connect_2[] PROGMEM = {
    // 'Screenshot 2024-03-02 123957, 128x64px
    0xff, 0xff, 0xff, 0xff, 0xff, 0xff, 0xff, 0xff, 0xff, 0xff, 0xff, 0xff, 0xff, 0xff, 0xff, 0xff,
    0xff, 0xff, 0xff, 0xff, 0xff, 0xff, 0xff, 0xff, 0xff, 0xff, 0xff, 0xff, 0xff, 0xff, 0xff, 0xff,
    0xff, 0xff, 0xff, 0xff, 0xff, 0xff, 0xff, 0xff, 0xff, 0xff, 0xff, 0xff, 0xff, 0xff, 0xff, 0xff,
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    0xff, 0xff, 0xff, 0xff, 0xff, 0xff, 0xff, 0xff, 0xff, 0xff, 0xff, 0xff, 0xff, 0xff, 0xff, 0xff};

const unsigned char connect_3[] PROGMEM = {
    // 'Screenshot 2024-03-02 124104, 128x64px
    0xff, 0xff, 0xff, 0xff, 0xff, 0xff, 0xff, 0xff, 0xff, 0xff, 0xff, 0xff, 0xff, 0xff, 0xff, 0xff,
    0xff, 0xff, 0xff, 0xff, 0xff, 0xff, 0xff, 0xff, 0xff, 0xff, 0xff, 0xff, 0xff, 0xff, 0xff, 0xff,
    0xff, 0xff, 0xff, 0xff, 0xff, 0xff, 0xff, 0xff, 0xff, 0xff, 0xff, 0xff, 0xff, 0xff, 0xff, 0xff,
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    0xff, 0xff, 0xff, 0xff, 0xff, 0xff, 0xff, 0xff, 0xff, 0xff, 0xff, 0xff, 0xff, 0xff, 0xff, 0xff};

const unsigned char welcome[] PROGMEM = {
    // 'Screenshot 2024-03-02 125210, 128x63px
    0xff, 0xff, 0xff, 0xff, 0xff, 0xff, 0xff, 0xff, 0xff, 0xff, 0xff, 0xff, 0xff, 0xff, 0xff, 0xff,
    0xff, 0xff, 0xff, 0xff, 0xff, 0xff, 0xff, 0xff, 0xff, 0xff, 0xff, 0xff, 0xff, 0xff, 0xff, 0xff,
    0xff, 0xff, 0xff, 0xff, 0xff, 0xff, 0xff, 0xff, 0xff, 0xff, 0xff, 0xff, 0xff, 0xff, 0xff, 0xff,
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    0xff, 0xff, 0xff, 0xff, 0xff, 0xff, 0xff, 0xff, 0xff, 0xff, 0xff, 0xff, 0xff, 0xff, 0xff, 0xff};

void set_display(String text, int column, int row, int text_size, bool isDisplay)
{
  display.setTextSize(text_size);
  display.setTextColor(SSD1306_WHITE);
  display.setCursor(column, row);
  display.println(text);

  if (isDisplay)
  {
    display.display();
  }
}

void print_time_now(void)
{
  configTime(UTC_OFFSET, UTC_OFFSET_DST, NTP_SERVER);
  display.clearDisplay();
  set_display("~Smart MediBox~", 15, 0, 1, false);
  set_display("Alarm : " + String(alarm_enabled ? "ON" : "OFF"), 0, 35, 1, false);
  set_display(String(hours) + ":" + String(minutes) + ":" + String(seconds), 20, 15, 2, false);
  set_display("Temperature : " + String(temperature), 0, 45, 1, false);
  set_display("Humidity : " + String(humidity), 0, 55, 1, true);
}

void update_time()
{
  struct tm timeinfo;
  getLocalTime(&timeinfo);

  char timeHour[3];
  strftime(timeHour, 3, "%H", &timeinfo);
  hours = atoi(timeHour);

  char timeMinute[3];
  strftime(timeMinute, 3, "%M", &timeinfo);
  minutes = atoi(timeMinute);

  char timeSecond[3];
  strftime(timeSecond, 3, "%S", &timeinfo);
  seconds = atoi(timeSecond);

  char timeDay[3];
  strftime(timeDay, 3, "%d", &timeinfo);
  days = atoi(timeDay);
}

void ring_alarm()
{
  display.clearDisplay();
  display.drawBitmap(0, 0, medicine_time, 128, 64, WHITE);
  display.display();

  bool break_happened = false;

  while (break_happened == false && digitalRead(PB_CANCEL) == HIGH)
  {
    for (int i = 0; i < n_notes; i++)
    {
      if (digitalRead(PB_CANCEL) == LOW)
      {
        delay(100);
        break_happened = true;
        break;
      }
      warning();
    }
  }
  display.clearDisplay();
}

void update_time_with_check_alarm(void)
{
  update_time();
  print_time_now();

  if (alarm_enabled == true)
  {
    for (int i = 0; i < n_alarms; i++)
    {
      if (alarm_triggered[i] == false && alarm_hours[i] == hours && alarm_minutes[i] == minutes)
      {
        ring_alarm();
        alarm_triggered[i] = true;
      }
    }
  }
}

int wait_for_button_press()
{
  while (true)
  {
    if (digitalRead(PB_UP) == LOW)
    {
      button_blink();
      delay(200);
      return PB_UP;
    }
    if (digitalRead(PB_DOWN) == LOW)
    {
      button_blink();
      delay(200);
      return PB_DOWN;
    }
    if (digitalRead(PB_OK) == LOW)
    {
      button_blink();
      delay(200);
      return PB_OK;
    }
    if (digitalRead(PB_CANCEL) == LOW)
    {
      button_blink();
      delay(200);
      return PB_CANCEL;
    }
    update_time();
  }
}

void print_modes(int mode)
{
  display.clearDisplay();
  set_display("->", 0, mode * 10, 1, false);
  set_display(modes[0], 15, 0, 1, false);
  set_display(modes[1], 15, 10, 1, false);
  set_display(modes[2], 15, 20, 1, false);
  set_display(modes[3], 15, 30, 1, false);
  set_display(modes[4], 15, 40, 1, true);
}

void go_to_menu()
{
  current_mode = 0;
  while (digitalRead(PB_CANCEL) == HIGH)
  {
    print_modes(current_mode);

    int pressed = wait_for_button_press();

    if (pressed == PB_DOWN)
    {
      delay(200);
      current_mode += 1;
      print_modes(current_mode);
      current_mode = current_mode % max_modes;
    }
    else if (pressed == PB_UP)
    {
      delay(200);
      current_mode -= 1;
      print_modes(current_mode);
      if (current_mode < 0)
      {
        current_mode = max_modes - 1;
      }
    }
    else if (pressed == PB_OK)
    {
      delay(200);
      Serial.println(current_mode);
      run_mode(current_mode);
    }
    else if (pressed == PB_CANCEL)
    {
      delay(200);
      break;
    }
  }
}

void run_mode(int mode)
{
  if (mode == 0)
  {
    set_time();
  }
  if (mode == 1 || mode == 2 || mode == 3)
  {
    set_alarm(mode - 1);
  }
  if (mode == 4)
  {
    alarm_enabled = false;
    display.clearDisplay();
    set_display("Disabled all Alarms !", 0, 0, 1, true);
    delay(500);
  }
}

void set_time()
{
  int temp_hour = hours;
  int temp_minutes = minutes;
  int hour_minute = 0;

  while (true)
  {
    display.clearDisplay();
    if (hour_minute == 0)
    {
      set_display("Set Time - hours", 20, 0, 1, false);
      set_display("->", 0, 20, 2, false);
      set_display(String(temp_hour), 30, 20, 2, false);
      set_display(":", 55, 20, 2, false);
      set_display(String(temp_minutes), 70, 20, 2, true);
    }
    else
    {
      set_display("Set Time - minutes", 10, 0, 1, false);
      set_display(String(temp_hour), 30, 20, 2, false);
      set_display(":", 55, 20, 2, false);
      set_display(String(temp_minutes), 70, 20, 2, false);
      set_display("<-", 95, 20, 2, true);
    }
    int pressed = wait_for_button_press();

    if (pressed == PB_UP)
    {
      delay(200);
      if (hour_minute == 0)
      {
        temp_hour += 1;
        temp_hour = temp_hour % 24;
      }
      else
      {
        temp_minutes += 1;
        temp_minutes = temp_minutes % 60;
      }
    }
    else if (pressed == PB_DOWN)
    {
      delay(200);
      if (hour_minute == 0)
      {
        temp_hour -= 1;
        if (temp_hour < 0)
        {
          temp_hour = 23;
        }
      }
      else
      {
        temp_minutes -= 1;
        if (temp_minutes < 0)
        {
          temp_minutes = 59;
        }
      }
    }
    else if (pressed == PB_OK)
    {
      delay(200);
      if (hour_minute == 0)
      {
        UTC_OFFSET += (temp_hour - hours) * 3600;
        hour_minute++;
      }
      else
      {
        UTC_OFFSET += (temp_minutes - minutes) * 60;
        break;
      }
    }
    else if (pressed == PB_CANCEL)
    {
      delay(200);
      display.clearDisplay();
      set_display("Canceled !", 40, 30, 1, true);
      delay(500);
      return;
    }
  }
  Serial.println("UTC OFFSET is " + String(UTC_OFFSET));
  configTime(UTC_OFFSET, UTC_OFFSET_DST, NTP_SERVER);
  display.clearDisplay();
  set_display("Time is set", 20, 30, 1, true);
  delay(500);
}

void set_alarm(int alarm)
{
  int temp_hour = alarm_hours[alarm];
  int temp_minutes = alarm_minutes[alarm];
  int hour_minute = 0;

  while (true)
  {
    display.clearDisplay();
    set_display("Set Alarm : " + String(alarm + 1), 25, 0, 1, false);
    if (hour_minute == 0)
    {
      set_display("->", 0, 20, 2, false);
      set_display(String(temp_hour), 30, 20, 2, false);
      set_display(":", 55, 20, 2, false);
      set_display(String(temp_minutes), 70, 20, 2, true);
    }
    else
    {
      set_display(String(temp_hour), 30, 20, 2, false);
      set_display(":", 55, 20, 2, false);
      set_display(String(temp_minutes), 70, 20, 2, false);
      set_display("<-", 95, 20, 2, true);
    }

    int pressed = wait_for_button_press();

    if (pressed == PB_UP)
    {
      delay(200);
      if (hour_minute == 0)
      {
        temp_hour += 1;
        temp_hour = temp_hour % 24;
      }
      else
      {
        temp_minutes += 1;
        temp_minutes = temp_minutes % 60;
      }
    }
    else if (pressed == PB_DOWN)
    {
      delay(200);
      if (hour_minute == 0)
      {
        temp_hour -= 1;
        if (temp_hour < 0)
        {
          temp_hour = 23;
        }
      }
      else
      {
        temp_minutes -= 1;
        if (temp_minutes < 0)
        {
          temp_minutes = 59;
        }
      }
    }

    else if (pressed == PB_OK)
    {
      delay(200);
      if (hour_minute == 0)
      {
        alarm_hours[alarm] = temp_hour;
        hour_minute++;
      }
      else
      {
        alarm_minutes[alarm] = temp_minutes;
        alarm_enabled = true;
        break;
      }
    }
    else if (pressed == PB_CANCEL)
    {
      delay(200);
      display.clearDisplay();
      set_display("Canceled !", 40, 30, 1, true);
      delay(500);
      return;
    }
  }

  display.clearDisplay();
  set_display("Alarm is set", 25, 30, 1, true);
  alarm_set();
  delay(500);
}

void warning()
{
  digitalWrite(LED_1, HIGH);
  tone(BUZZER, notes[0]);
  delay(200);
  noTone(BUZZER);
  digitalWrite(LED_1, LOW);
}

void check_temp()
{
  // int result = dhtSensor.readTemperatureHumidity(temperature, humidity);
  TempAndHumidity data = dhtSensor.getTempAndHumidity();
  temperature = data.temperature;
  humidity = data.humidity;

  Serial.println("Temperature : " + String(data.temperature));
  Serial.println("Humidity : " + String(data.humidity));

  char temperature[6];
  char humidity[6];

  String(data.temperature).toCharArray(temperature, 6);
  String(data.humidity).toCharArray(humidity, 6);

  mqttClient.publish("210134C-Medibox-temperature", temperature);
  mqttClient.publish("210134C-Medibox-humidity", humidity);

  if (data.temperature > MAX_TEMPERATURE)
  {
    display.clearDisplay();
    display.drawBitmap(0, 0, high_temp, 128, 64, WHITE);
    display.display();
    warning();
  }

  else if (data.temperature < MIN_TEMPERATURE)
  {
    display.clearDisplay();
    display.drawBitmap(0, 0, low_temp, 128, 64, WHITE);
    display.display();
    warning();
  }

  if (data.humidity > MAX_HUMIDITY)
  {
    display.clearDisplay();
    display.drawBitmap(0, 0, high_humidity, 128, 64, WHITE);
    display.display();
    warning();
  }

  else if (data.humidity < MIN_HUMIDITY)
  {
    display.clearDisplay();
    display.drawBitmap(0, 0, low_humidity, 128, 64, WHITE);
    display.display();
    warning();
  }
}

void boot_blink()
{
  for (int i = 0; i < 100; i++)
  {
    if (i % 2 == 0)
    {
      digitalWrite(LED_1, HIGH);
    }
    else
    {
      digitalWrite(LED_1, LOW);
    }
    delay(i);
  }
  digitalWrite(LED_1, LOW);
}

void play_buzzer()
{
  tone(BUZZER, notes[0]);
  delay(500);
  noTone(BUZZER);
  delay(500);
}

void button_blink()
{
  digitalWrite(LED_1, HIGH);
  delay(15);
  digitalWrite(LED_1, LOW);
}

// ----------------------------Extended Features--------------------------------------------

/**
 *  Initializes the initial servo angle and setup WiFi and MQTT
 */
void setup()
{
  pinMode(BUZZER, OUTPUT);
  pinMode(LED_1, OUTPUT);
  pinMode(PB_CANCEL, INPUT);
  pinMode(PB_OK, INPUT);
  pinMode(PB_UP, INPUT);
  pinMode(PB_DOWN, INPUT);

  angle_offset = 30;
  controlling_factor = 0.75;

  Serial.begin(9600);
  dhtSensor.setup(DHTPIN, DHTesp::DHT22);

  boot_blink();
  play_buzzer();
  if (!display.begin(SSD1306_SWITCHCAPVCC, SCREEN_ADDRESS))
  {
    Serial.println(F("SSD1306 allocation failed"));
    while (true)
      ;
  }

  setupWifi();
  setupMqtt();

  servo.attach(SERVO_PIN);   // Attach the servo to the specified pin
  servo.write(angle_offset); // Set initial angle

  configTime(UTC_OFFSET, UTC_OFFSET_DST, NTP_SERVER);

  display.clearDisplay();
  display.drawBitmap(0, 0, welcome, 128, 64, WHITE);
  display.display();
  delay(2000);
  display.clearDisplay();
  alarm_set();
}

/**
 *  It checks the MQTT connection, measures light intensity, and controls the servo as data received through the MQTT connection.
 */
void loop()
{
  update_time_with_check_alarm();
  if (digitalRead(PB_OK) == LOW)
  {
    button_blink();
    delay(200);
    go_to_menu();
  }
  check_temp();
  new_features();
}

void new_features()
{
  if (!mqttClient.connected())
  {
    connectToBroker();
  }

  mqttClient.loop();

  measure_light_intensity();

  servo_controller();
  delay(1000);
}

/**
 *  Function to set up the WiFi connection.
 *  It connects to the WiFi network and prints the IP address.
 */
void setupWifi()
{
  WiFi.begin("Wokwi-GUEST", "", 6);

  while (WiFi.status() != WL_CONNECTED)
  {
    display.clearDisplay();
    display.drawBitmap(0, 0, connect_1, 128, 64, WHITE);
    display.display();
    delay(1000);
    display.clearDisplay();
    display.drawBitmap(0, 0, connect_2, 128, 64, WHITE);
    display.display();
    delay(1000);
    display.clearDisplay();
    display.drawBitmap(0, 0, connect_3, 128, 64, WHITE);
    display.display();
    delay(1000);
  }

  Serial.println("");
  Serial.println("WiFi connected");
  Serial.println("IP address : ");
  Serial.println(WiFi.localIP());
}

/**
 *  Function to set up the MQTT connection.
 *  It sets the MQTT server and callback functions.
 */
void setupMqtt()
{
  mqttClient.setServer("test.mosquitto.org", 1883);
  mqttClient.setCallback(receiveCallBack);
}

/**
 *  Function to connect to the MQTT broker.
 *  It attempts to connect to the broker and subscribes to topics.
 *  It also publishes the initial control factor and minimum angle values.
 */
void connectToBroker()
{
  while (!mqttClient.connected())
  {
    Serial.print("Attempting MQTT connection...");
    if (mqttClient.connect("ESP32-4654564645645"))
    {
      Serial.println("connected");
      mqttClient.subscribe("210134C-Medibox-ct-factor");
      mqttClient.subscribe("210134C-Medibox-min-angle");
      mqttClient.subscribe("210134C-Medibox-alarm-1");
      mqttClient.subscribe("210134C-Medibox-alarm-2");
      mqttClient.subscribe("210134C-Medibox-alarm-3");

      char ctrl_factor[6];
      char min_angle[6];
      String(angle_offset).toCharArray(min_angle, 6);
      String(controlling_factor).toCharArray(ctrl_factor, 6);
      mqttClient.publish("210134C-Medibox-ct-factor", ctrl_factor);
      mqttClient.publish("210134C-Medibox-min-angle", min_angle);
    }
    else
    {
      Serial.println("failed");
      Serial.println(mqttClient.state());
      delay(500);
    }
  }
}

/**
 *  Callback function for receiving MQTT messages.
 *  It handles the received messages and updates the control factor and minimum angle values.
 *  topic - The topic of the received message.
 *  payload - The payload of the received message.
 *  length - The length of the payload.
 */
void receiveCallBack(char *topic, byte *payload, unsigned int length)
{
  Serial.print("Message Arrived [");
  Serial.print(topic);
  Serial.print("]");

  char payloadCharAr[length];

  for (int i = 0; i < length; i++)
  {
    Serial.print((char)payload[i]);
    payloadCharAr[i] = (char)payload[i];
  }

  Serial.println();

  if (strcmp(topic, "210134C-Medibox-ct-factor") == 0)
  {
    controlling_factor = atof(payloadCharAr);
    Serial.println(controlling_factor);
    servo_controller();
  }
  else if (strcmp(topic, "210134C-Medibox-min-angle") == 0)
  {
    angle_offset = atof(payloadCharAr);
    Serial.println(angle_offset);
    servo_controller();
  }
  else if (strcmp(topic, "210134C-Medibox-alarm-1") == 0)
  {
    if (payloadCharAr[0] == '1')
    {
      alarm_triggered[0] = true;
      alarm_enabled = true;
    }
    else
    {
      alarm_triggered[0] = false;
      if (!(alarm_triggered[1] || alarm_triggered[2]))
      {
        alarm_enabled = false;
      }
    }
  }
  else if (strcmp(topic, "210134C-Medibox-alarm-2") == 0)
  {
    if (payloadCharAr[0] == '1')
    {
      alarm_triggered[1] = true;
      alarm_enabled = true;
    }
    else
    {
      alarm_triggered[1] = false;
      if (!(alarm_triggered[0] || alarm_triggered[2]))
      {
        alarm_enabled = false;
      }
    }
  }
  else if (strcmp(topic, "210134C-Medibox-alarm-3") == 0)
  {
    if (payloadCharAr[0] == '1')
    {
      alarm_triggered[2] = true;
      alarm_enabled = true;
    }
    else
    {
      alarm_triggered[2] = false;
      if (!(alarm_triggered[1] || alarm_triggered[0]))
      {
        alarm_enabled = false;
      }
    }
  }
}

/**
 *  Function to measure the light intensity using LDR sensors.
 *  It reads the analog values from the sensors and calculates the light intensity.
 *  It publishes the light intensity value to the MQTT broker.
 */
void measure_light_intensity()
{
  analogReadResolution(10); // Set the resolution to 12 bits (0-4095)
  right_intensity = analogRead(LDR_RIGHT);
  left_intensity = analogRead(LDR_LEFT);

  right_intensity = 1 - (right_intensity / 1023); // esp32 ADC resolution is 12bits therefore the input is divided by 2^12-1
  left_intensity = 1 - (left_intensity / 1023);

  Serial.println("Left light intensity : " + String(left_intensity));
  Serial.println("Right light intensity : " + String(right_intensity));

  char light_intensity[6];

  if (left_intensity >= right_intensity)
  {
    String(left_intensity).toCharArray(light_intensity, 6);
  }
  else
  {
    String(right_intensity).toCharArray(light_intensity, 6);
  }
  mqttClient.publish("210134C-Medibox-light-intensity", light_intensity);
}

/**
 *  Function to control the servo motor based on the light intensity.
 *  It calculates the desired angle based on the control factor, minimum angle, and light intensity.
 *  It sets the servo angle to the calculated value.
 */
void servo_controller()
{
  float D = 0;
  if (left_intensity > 0.95)
  {
    D = 1.5;
  }
  else if (right_intensity > 0.95)
  {
    D = 0.5;
  }
  int angle = min(int((angle_offset * D) + ((180 - angle_offset) * max(left_intensity, right_intensity) * controlling_factor)), 180);
  servo.write(angle);
}

/**
 *  Function to set Alarms using Node-Red Dashboard and update the Dashboard.
 */
void alarm_set()
{
  char alarm_1[1];
  char alarm_2[1];
  char alarm_3[1];

  int alarm01 = alarm_triggered[0] ? 1 : 0;
  int alarm02 = alarm_triggered[1] ? 1 : 0;
  int alarm03 = alarm_triggered[2] ? 1 : 0;

  String(alarm01).toCharArray(alarm_1, 1);
  String(alarm02).toCharArray(alarm_2, 1);
  String(alarm03).toCharArray(alarm_3, 1);

  mqttClient.publish("210134C-Medibox-alarm-1", alarm_1);
  mqttClient.publish("210134C-Medibox-alarm-2", alarm_2);
  mqttClient.publish("210134C-Medibox-alarm-3", alarm_3);
}